## arch/arm64/Kconfig.fitimage
```kconfig
# SPDX-License-Identifier: GPL-2.0-only

menu "FIT image settings"

config FIT_IMAGE
	bool "Include a FIT image in Debian kernel packages"
	help
	  Build fitImage during bindeb-pkg and include it as
	  /boot/fitImage-<kernel-release> in the linux-image package.
	  Requires the host mkimage and dtc tools and the FIT settings below.
	  If disabled, Debian packaging does not build or include a FIT image.

config FIT_DEVICETREE
	string "FIT device trees and overlays"
	help
	  Space-separated DTB and DTBO paths relative to arch/arm64/boot/dts.
	  The first entry should be a base DTB. These files are built and
	  included by the fitImage target.

config UBOOT_LOADADDRESS
	string "FIT kernel load address"
	help
	  Kernel load address in hexadecimal, for example 0x80400000.

config UBOOT_ENTRYPOINT
	string "FIT kernel entry point"
	help
	  Kernel entry address in hexadecimal.

config UBOOT_DTB_LOADADDRESS
	string "FIT device tree load address"
	help
	  Base device tree load address in hexadecimal.

config UBOOT_DTBO_LOADADDRESS
	string "FIT overlay load address"
	help
	  Device tree overlay load address in hexadecimal.

endmenu
```

## drivers/net/wireless/nxp/Kconfig
```kconfig
# SPDX-License-Identifier: GPL-2.0-only
config WLAN_VENDOR_NXP
	bool "NXP WiFi-Ex Driver"
	depends on CFG80211
	default n
	help
	  If you have a wireless card belonging to this class, say Y.

	  Note that the answer to this question doesn't directly affect the
	  kernel: saying N will just cause the configurator to skip all the
	  questions about these cards. If you say Y, you will be asked for
	  your specific card in the following questions.
```
