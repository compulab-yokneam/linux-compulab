#include "overlay.h"

&{/chosen/overlays} {
	overlay-sbev-ucmimx8plus-csi2-isp1 = "SBEV-UCM-iMX8Plus: CSI2 ISP1";
};

#include "sbev-ucmimx8plus-csi2-isp1.dtsi"

&{/} {
	model = "CompuLab UCM-iMX8M-Plus with csi2/isp1 enabled on EB-EVCAMBLR";
	compatible = "compulab,ucm-imx8m-plus", "fsl,imx8mp";
};
