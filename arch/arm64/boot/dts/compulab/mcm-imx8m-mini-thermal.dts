/*
 * Copyright 2018 CompuLab
 *
 * This program is free software; you can redistribute it and/or
 * modify it under the terms of the GNU General Public License
 * as published by the Free Software Foundation; either version 2
 * of the License, or (at your option) any later version.
 *
 * This program is distributed in the hope that it will be useful,
 * but WITHOUT ANY WARRANTY; without even the implied warranty of
 * MERCHANTABILITY or FITNESS FOR A PARTICULAR PURPOSE.  See the
 * GNU General Public License for more details.
 */

/* !!!!!!!!!!!!!!!!!!!!!!!!!!!!!!!!!!!!!!!!
* This DT is intended for lab purposes ONLY
!!!!!!!!!!!!!!!!!!!!!!!!!!!!!!!!!!!!!!!!!*/

/dts-v1/;

#include "mcm-imx8m-mini.dtsi"

/ {
	model = "CompuLab MCM i.MX8MM board (thermal)";
	compatible = "cpl,mcm-imx8m-mini", "fsl,imx8mm";
};

&cpu_alert0 {
	temperature = <125000>;
};

&cpu_crit0 {
	temperature = <155000>;
};
