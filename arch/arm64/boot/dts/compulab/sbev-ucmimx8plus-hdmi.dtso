#include "overlay.h"

&{/chosen/overlays} {
	overlay-sbev-ucmimx8plus-hdmi = "SBEV-UCM-iMX8Plus: HDMI";
};

#include "ucm-imx8m-plus-hdmi.dtsi"

&{/} {
	model = "CompuLab UCM-iMX8M-Plus (hdmi) on SBEV";
	compatible = "compulab,ucm-imx8m-plus", "fsl,imx8mp";
};
