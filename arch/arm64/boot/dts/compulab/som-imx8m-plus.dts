// SPDX-License-Identifier: (GPL-2.0+ OR MIT)
/*
 * Copyright 2021 CompuLab
 */

/dts-v1/;

#include "som-imx8m-plus-headless.dts"
#include "som-imx8m-plus-mipi.dtsi"
#include "som-imx8m-plus-lvds.dtsi"
#include "som-imx8m-plus-hdmi.dtsi"

/ {
	model = "CompuLab SOM-iMX8M-Plus, multiple displays";
	compatible = "compulab,som-imx8m-plus", "fsl,imx8mp";
};
