#include "overlay.h"

&{/chosen/overlays} {
	overlay-mcm-imx8m-plus-uart1 = "MCM-iMX8M-Plus: UART1";
};

#include "mcm-imx8m-plus-uart1.dtsi"

/ {
	model = "CompuLab MCM-iMX8M-Plus (uart1)";
	compatible = "compulab,mcm-imx8m-plus", "fsl,imx8mp";
};
