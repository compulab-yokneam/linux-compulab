#include "overlay.h"
#include "ucm-imx8m-plus_mipi-csi1.dtsi"

&{/} {
	model = "CompuLab MCM-iMX8M-Plus with ar_1335_mcu mipi csi1 enabled";
	compatible = "compulab,mcm-imx8m-plus", "fsl,imx8mp";
};

&sensor_mipi1 {
	compatible = "aptina,ar1335_mcu", "ar1335_mcu";
	pwdn-gpios = <&pca9555 8 GPIO_ACTIVE_LOW>;
};

&mipi1_ep {
	data-lanes = <1 2>;
};

&mipi1_sensor_ep {
	data-lanes = <2>;
};
