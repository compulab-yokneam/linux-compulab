#include "overlay.h"

&{/chosen/overlays} {
	overlay-iotg-imx8pv2-do2 = "IOT-GATE-iMX8Plus v2: do2";
};

/* Disable Digital Input 2 by applying a hog configuration to the underlying GPIO. */

&di2_dis {
	status = "okay";
};

/* Enable Digital Output 2 by removing the hog configuration from the underlying GPIO. */
&do2_dis {
	status = "disabled";
};
