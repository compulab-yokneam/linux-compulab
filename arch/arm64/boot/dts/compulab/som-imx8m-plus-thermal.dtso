#include "overlay.h"

&{/chosen/overlays} {
	overlay-som-imx8m-plus-thermal = "SOM-iMX8M-Plus: thermal limits";
};

#include "compulab-imx8m-plus-thermal.dtsi"

/ {
	model = "CompuLab SOM-iMX8M-Plus (thermal)";
	compatible = "compulab,som-imx8m-plus", "fsl,imx8mp";
};
