&lpspi7 {
    #address-cells = <1>;
    #size-cells = <0>;

    fsl,spi-num-chipselects = <1>;
    pinctrl-names = "default", "sleep";
    pinctrl-0 = <&pinctrl_lpspi7>;
    pinctrl-1 = <&pinctrl_lpspi7>;
    cs-gpios = <&gpio2 4 GPIO_ACTIVE_LOW>;
    status = "okay";

    spidev0: spi@0 {
        reg = <0>;
        compatible = "lwn,bk4";
        spi-max-frequency = <1000000>;
        status = "okay";
    };
};

&scmi_iomuxc {
    pinctrl_lpspi7: lpspi7grp {
        fsl,pins = <
            IMX95_PAD_GPIO_IO04__GPIO2_IO_BIT4      0x3fe
            IMX95_PAD_GPIO_IO05__LPSPI7_SIN         0x3fe
            IMX95_PAD_GPIO_IO06__LPSPI7_SOUT        0x3fe
            IMX95_PAD_GPIO_IO07__LPSPI7_SCK         0x3fe
        >;
    };
};
