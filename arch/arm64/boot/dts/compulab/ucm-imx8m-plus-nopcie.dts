/*
 * Copyright 2021 CompuLab
 *
 * This program is free software; you can redistribute it and/or
 * modify it under the terms of the GNU General Public License
 * as published by the Free Software Foundation; either version 2
 * of the License, or (at your option) any later version.
 *
 * This program is distributed in the hope that it will be useful,
 * but WITHOUT ANY WARRANTY; without even the implied warranty of
 * MERCHANTABILITY or FITNESS FOR A PARTICULAR PURPOSE.  See the
 * GNU General Public License for more details.
 */

/dts-v1/;

#include "ucm-imx8m-plus.dts"

/ {
	model = "CompuLab UCM-iMX8M-Plus (nopcie)";
	compatible = "compulab,ucm-imx8m-plus", "fsl,imx8mp";
};

&pcie {
	status = "disabled";
};

&pcie_ep {
	status = "disabled";
};

&pcie_phy {
	status = "disabled";
};
