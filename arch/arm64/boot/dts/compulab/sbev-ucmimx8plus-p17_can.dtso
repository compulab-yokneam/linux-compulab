#include "overlay.h"

&{/chosen/overlays} {
	overlay-sbev-ucmimx8plus-p17-can = "SBEV-UCM-iMX8Plus: p17 CAN";
};

#include "sbev-ucmimx8plus-p17_can.dtsi"

/ {
	model = "CompuLab MCM-iMX8M-Plus (p17_can)";
	compatible = "compulab,mcm-imx8m-plus", "fsl,imx8mp";
};
