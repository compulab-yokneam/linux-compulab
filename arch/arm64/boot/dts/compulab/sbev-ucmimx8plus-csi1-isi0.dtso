#include "overlay.h"

&{/chosen/overlays} {
	overlay-sbev-ucmimx8plus-csi1-isi0 = "SBEV-UCM-iMX8Plus: CSI1 ISI0";
};

#include "sbev-ucmimx8plus-csi1-isi0.dtsi"

&{/} {
	model = "CompuLab UCM-iMX8M-Plus with csi1/isi0 enabled on EB-EVCAMBLR";
	compatible = "compulab,ucm-imx8m-plus", "fsl,imx8mp";
};
