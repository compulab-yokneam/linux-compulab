// SPDX-License-Identifier: (GPL-2.0+ OR MIT)
/* Copyright 2026 CompuLab Ltd. */

&ecspi1 {
	#address-cells = <1>;
	#size-cells = <0>;
	num-cs = <1>;
	pinctrl-names = "default";
	pinctrl-0 = <&pinctrl_sbc_p16_spi>;
	cs-gpios = <&gpio5 9 GPIO_ACTIVE_LOW>;
	status = "okay";

	/* SBEV userspace SPI placeholder; replace for a specific peripheral. */
	spidev@0 {
		compatible = "rohm,dh2228fv";
		reg = <0>;
		spi-max-frequency = <500000>;
	};
};

&iomuxc {
	pinctrl_sbc_p16_spi: sbc-p16-spigrp {
		fsl,pins = <
			MX8MP_IOMUXC_ECSPI1_SCLK__ECSPI1_SCLK	0x82 /* P16.7 */
			MX8MP_IOMUXC_ECSPI1_MOSI__ECSPI1_MOSI	0x82 /* P16.6 */
			MX8MP_IOMUXC_ECSPI1_MISO__ECSPI1_MISO	0x82 /* P16.2 */
			MX8MP_IOMUXC_ECSPI1_SS0__GPIO5_IO09	0x40000 /* P16.4 */
		>;
	};
};
