// SPDX-License-Identifier: (GPL-2.0+ OR MIT)
/*
 * Copyright 2026 CompuLab Ltd.
 */

/dts-v1/;

#include "ucm-imx8m-plus-som.dts"
#include "ucm-imx8m-plus-pcie.dtsi"
#include "sbev-ucmimx8plus.dtsi"
#include "sbev-ucmimx8plus-mmc2.dtsi"

/ {
	model = "CompuLab UCM-iMX8M-Plus (sbev)";
	compatible = "compulab,ucm-imx8m-plus", "fsl,imx8mp";
};
