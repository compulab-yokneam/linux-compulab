#include "overlay.h"
#include "ucm-imx8m-plus_mipi-csi2.dtsi"

&{/} {
	model = "CompuLab MCM-iMX8M-Plus with ar_1335_af mipi csi2 enabled";
	compatible = "compulab,mcm-imx8m-plus", "fsl,imx8mp";
};

&sensor_mipi2 {
	compatible = "econ,ar1335_af", "ar1335_af";
};
