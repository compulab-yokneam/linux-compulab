// SPDX-License-Identifier: (GPL-2.0+ OR MIT)
/*
 * Copyright 2022 NXP
 */

/dts-v1/;
/plugin/;

#include <dt-bindings/gpio/gpio.h>
#include "mcm-imx93-thermal.dtsi"

/ {
	model = "CompuLab MCM-i.MX93 board, thermal-overlay";
};
