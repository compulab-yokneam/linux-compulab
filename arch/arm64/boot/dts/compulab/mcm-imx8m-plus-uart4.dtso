#include "overlay.h"

&{/chosen/overlays} {
	overlay-mcm-imx8m-plus-uart4 = "MCM-iMX8M-Plus: UART4";
};

#include "mcm-imx8m-plus-uart4.dtsi"

/ {
	model = "CompuLab MCM-iMX8M-Plus (uart4)";
	compatible = "compulab,mcm-imx8m-plus", "fsl,imx8mp";
};
