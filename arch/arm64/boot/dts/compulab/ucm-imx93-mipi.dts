// SPDX-License-Identifier: (GPL-2.0+ OR MIT)
/*
 * Copyright 2023 Compulab
 */

/dts-v1/;

#include "ucm-imx93.dtsi"
#include "ucm-imx93-mipi.dtsi"

/ {
	model = "CompuLab UCM-i.MX93 board, build-in-mipi";
	compatible = "compulab,ucm-imx93", "fsl,imx93";
};
