// SPDX-License-Identifier: (GPL-2.0+ OR MIT)
/*
 * Copyright 2024 CompuLab LTD.
 */

&flexspi {
	pinctrl-names = "default";
	pinctrl-0 = <&pinctrl_flexspi0>;
	status = "okay";

	flash0: mt25qu256aba@0 {
		reg = <0>;
		#address-cells = <1>;
		#size-cells = <1>;
		compatible = "jedec,spi-nor";
		spi-max-frequency = <80000000>;
		spi-tx-bus-width = <4>;
		spi-rx-bus-width = <4>;
	};
};

&iomuxc {
	pinctrl_flexspi0: flexspi0grp {
		fsl,pins = <
			MX8MP_IOMUXC_NAND_ALE__FLEXSPI_A_SCLK				0x1c2
			MX8MP_IOMUXC_NAND_CE0_B__FLEXSPI_A_SS0_B			0x82
			MX8MP_IOMUXC_NAND_DATA00__FLEXSPI_A_DATA00			0x82
			MX8MP_IOMUXC_NAND_DATA01__FLEXSPI_A_DATA01			0x82
			MX8MP_IOMUXC_NAND_DATA02__FLEXSPI_A_DATA02			0x82
			MX8MP_IOMUXC_NAND_DATA03__FLEXSPI_A_DATA03			0x82
		>;
	};
};
