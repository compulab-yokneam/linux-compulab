#include "overlay.h"

&{/chosen/overlays} {
	overlay-mcm-imx8m-plus-can = "MCM-iMX8M-Plus: CAN";
};

#include "mcm-imx8m-plus-can.dtsi"

/ {
	model = "CompuLab MCM-iMX8M-Plus (can)";
	compatible = "compulab,mcm-imx8m-plus", "fsl,imx8mp";
};
