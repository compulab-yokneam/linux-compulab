#include "overlay.h"

&{/chosen/overlays} {
	overlay-mcm-imx8m-plus-headless-header = "MCM-iMX8M-Plus: headless header";
};

&{/} {
	model = "CompuLab MCM-iMX8M-Plus (headless)";
	compatible = "compulab,mcm-imx8m-plus", "fsl,imx8mp";
};
