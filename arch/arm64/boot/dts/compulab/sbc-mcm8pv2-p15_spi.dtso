// SPDX-License-Identifier: (GPL-2.0+ OR MIT)
/* Copyright 2026 CompuLab Ltd. */

#include "overlay.h"

&{/chosen/overlays} {
	overlay-sbc-mcm8pv2-p15_spi = "SBC-MCM8PV2: ECSPI2 on P15";
};

#include "sbc-mcm8pv2-p15_spi.dtsi"
