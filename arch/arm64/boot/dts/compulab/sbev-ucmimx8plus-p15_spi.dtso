#include "overlay.h"

&{/chosen/overlays} {
	overlay-sbev-ucmimx8plus-p15-spi = "SBEV-UCM-iMX8Plus: p15 SPI";
};

#include "sbev-ucmimx8plus-p15_spi.dtsi"

/ {
	model = "CompuLab MCM-iMX8M-Plus (p15_spi)";
	compatible = "compulab,mcm-imx8m-plus", "fsl,imx8mp";
};
