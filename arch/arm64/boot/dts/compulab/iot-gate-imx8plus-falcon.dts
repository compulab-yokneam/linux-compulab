// SPDX-License-Identifier: (GPL-2.0+ OR MIT)
/*
 * Copyright 2024 CompuLab Ltd
 */

#include "ucm-imx8m-plus.dtsi"
#include "ucm-imx8m-plus-can.dtsi"
#include "ucm-imx8m-plus-pcie.dtsi"
#include "sb-iotgimx8plus.dtsi"

/ {
	model = "CompuLab IOT-GATE-IMX8PLUS falcon";
	compatible = "compulab,iot-gate-imx8plus", "compulab,ucm-imx8m-plus-som", "fsl,imx8mp";
	memory@40000000 {
		device_type = "memory";
		reg = <0x0 0x40000000 0 0x80000000>;
	};
};

&resmem {
	/delete-node/linux,cma;
};
