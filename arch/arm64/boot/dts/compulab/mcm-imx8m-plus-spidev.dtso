#include "overlay.h"

&{/chosen/overlays} {
	overlay-mcm-imx8m-plus-spidev = "MCM-iMX8M-Plus: SPI device";
};

#include "compulab-imx8m-plus-spidev.dtsi"

/ {
	model = "CompuLab MCM-iMX8M-Plus (spidev)";
	compatible = "compulab,mcm-imx8m-plus", "fsl,imx8mp";
};
