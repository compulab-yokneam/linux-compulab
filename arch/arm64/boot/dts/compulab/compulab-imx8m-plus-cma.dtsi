/*
 * Extra cma area range for 4G RAM setup
 *
 */

&resmem {
	/* global autoconfigured region for contiguous allocations */
	linux,cma {
		compatible = "shared-dma-pool";
		reusable;
		size = <0 0x2c000000>;
		alloc-ranges = <0 0x40000000 0 0xC0000000>;
		linux,cma-default;
	};
};
