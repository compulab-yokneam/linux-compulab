// SPDX-License-Identifier: (GPL-2.0+ OR MIT)
/* MCM carrier camera wiring, independent of its display choice. */
&lpi2c3 {
	clock-frequency = <400000>;
	pinctrl-names = "default";
	pinctrl-0 = <&pinctrl_lpi2c3>;
	status = "okay";
	sensor_mipi2: mipi2@42 {
		compatible = "aptina,ar1335_mcu";
		reg = <0x42>;
		clocks = <&clk IMX93_CLK_MIPI_PHY_CFG>;
		clock-names = "xclk";
		pwdn-gpios = <&pca9555 8 GPIO_ACTIVE_HIGH>;
		pwn-gpios = <&pca9555 8 GPIO_ACTIVE_HIGH>;
		rst-gpios = <&pca9555 9 GPIO_ACTIVE_LOW>;
		mclk = <24000000>;
		mclk_source = <0>;
		mipi_csi;
		camera_mipi_lanes = <2>;
		status = "disabled";

		port {
			ar1335_mipi_ep: endpoint {
				remote-endpoint = <&mipi_csi_ep>;
				data-lanes = <1 2>;
				clock-lanes = <0>;
			};
		};
	};
};

#include "compulab-imx93-camera.dtsi"
