&uart1 { /* console optional */
	pinctrl-names = "default";
	pinctrl-0 = <&pinctrl_uart1>;
	assigned-clocks = <&clk IMX8MP_CLK_UART1>;
	assigned-clock-parents = <&clk IMX8MP_SYS_PLL1_80M>;
	status = "okay";
};

&iomuxc {
	pinctrl_uart1: uart1grp {
		fsl,pins = <
			MX8MP_IOMUXC_SAI2_RXFS__UART1_DCE_TX	0x49 /* P2-88/P20-18 */
			MX8MP_IOMUXC_SD1_CMD__UART1_DCE_RX	0x49 /* P2-70/P20-17 */
		>;
	};
};
