/dts-v1/;
/plugin/;

#include <dt-bindings/clock/imx8mp-clock.h>
#include <dt-bindings/power/imx8mp-power.h>
#include <dt-bindings/reset/imx8mp-reset.h>
#include <dt-bindings/power/imx8mp-power.h>
#include <dt-bindings/gpio/gpio.h>
#include <dt-bindings/input/input.h>
#include <dt-bindings/interrupt-controller/arm-gic.h>
#include <dt-bindings/thermal/thermal.h>
#include "../freescale/imx8mp-pinfunc.h"
#include "ucm-imx8m-plus_mipi-csi2.dtsi"

&{/} {
	model = "CompuLab UCM-iMX8M-Plus with ar_0521 mipi csi2 enabled";
	compatible = "compulab,ucm-imx8m-plus", "fsl,imx8mp";
};

&sensor_mipi2 {
	compatible = "econ,ar0521", "ar0521";
};
