#include "overlay.h"

&{/chosen/overlays} {
	overlay-sbev-ucmimx8plus-p19-uart-b = "SBEV-UCM-iMX8Plus: p19 UART b";
};

#include "sbev-ucmimx8plus-p19_uart-b.dtsi"

/ {
	model = "CompuLab MCM-iMX8M-Plus (p19_uart-b)";
	compatible = "compulab,mcm-imx8m-plus", "fsl,imx8mp";
};
