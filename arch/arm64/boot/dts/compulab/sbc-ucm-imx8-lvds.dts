/*
 * Copyright (C) 2018 CopuLab Ltd.
 *
 * This program is free software; you can redistribute it and/or
 * modify it under the terms of the GNU General Public License
 * as published by the Free Software Foundation; either version 2
 * of the License, or (at your option) any later version.
 *
 * This program is distributed in the hope that it will be useful,
 * but WITHOUT ANY WARRANTY; without even the implied warranty of
 * MERCHANTABILITY or FITNESS FOR A PARTICULAR PURPOSE.  See the
 * GNU General Public License for more details.
 */

#include "sbc-ucm-imx8.dts"
#include "compulab-imx8mq-lvds-mipi.dtsi"
#include "compulab-imx8mq-mipi-lcdif.dtsi"

/ {
    model = "CompuLab UCM-iMX8 on SBC-UCM-iMX8 + LVDS";
    compatible = "compulab,sbc-ucm-imx8", "compulab,ucm-imx8", "fsl,imx8mq";
};

&ti_bridge {
    enable-gpios = <&pca9555 10 GPIO_ACTIVE_HIGH>;
};

&i2c4 {
    status = "okay";
    goodix_ts@5d {
        compatible = "goodix,gt911";
        reg = <0x5d>;

        pinctrl-names = "default";
        pinctrl-0 = <&touchscreen_pins>;

        interrupt-parent = <&gpio5>;
        interrupts = <25 IRQ_TYPE_EDGE_FALLING>;

        irq-gpios = <&gpio5 25 GPIO_ACTIVE_HIGH>;
        reset-gpios = <&pca9555 14 GPIO_ACTIVE_HIGH>;
        status = "okay";
    };
};
