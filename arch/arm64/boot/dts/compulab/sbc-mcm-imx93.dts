// SPDX-License-Identifier: (GPL-2.0+ OR MIT)
/*
 * Copyright 2023 Compulab
 */

/dts-v1/;

#include "mcm-imx93.dtsi"
#include "sbc-mcm-imx93-leds.dtsi"
#include "sbc-mcm-imx93-uart.dtsi"
#include "sbc-mcm-imx93-ethernet.dtsi"

/ {
	model = "CompuLab MCM-i.MX93 board, build-in-lvds";
	compatible = "compulab,mcm-imx93", "fsl,imx93";
};
