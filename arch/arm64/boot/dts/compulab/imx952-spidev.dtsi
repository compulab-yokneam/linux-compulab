// SPDX-License-Identifier: (GPL-2.0+ OR MIT)
/*
 * Copyright 2026 CompuLab
 */

&lpspi7 {
	#address-cells = <1>;
	#size-cells = <0>;
	fsl,spi-num-chipselects = <1>;
	status = "okay";

	spidev0: spi@0 {
		compatible = "lwn,bk4";
		reg = <0>;
		spi-max-frequency = <1000000>;
		status = "okay";
	};
};
