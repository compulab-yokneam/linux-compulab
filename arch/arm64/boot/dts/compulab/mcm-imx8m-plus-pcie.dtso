#include "overlay.h"

&{/chosen/overlays} {
	overlay-mcm-imx8m-plus-pcie = "MCM-iMX8M-Plus: PCIe";
};

#include "mcm-imx8m-plus-pcie.dtsi"

/ {
	model = "CompuLab MCM-iMX8M-Plus (pice)";
	compatible = "compulab,mcm-imx8m-plus", "fsl,imx8mp";
};
