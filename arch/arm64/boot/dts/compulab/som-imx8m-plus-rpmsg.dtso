#include "overlay.h"

&{/chosen/overlays} {
	overlay-som-imx8m-plus-rpmsg = "SOM-iMX8M-Plus: RPMsg";
};

#include "compulab-imx8m-plus-rpmsg.dtsi"

/ {
	model = "CompuLab SOM-iMX8M-Plus (rpmsg)";
	compatible = "compulab,som-imx8m-plus", "fsl,imx8mp";
};
