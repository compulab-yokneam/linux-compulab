// SPDX-License-Identifier: (GPL-2.0+ OR MIT)
/*
 * Copyright 2024 CompuLab
 */

/dts-v1/;

#include "mcm-imx8m-plus-som.dts"
#include "mcm-imx8m-plus-mmc2.dtsi"
#include "mcm-imx8m-plus-sd8997.dtsi"
#include "mcm-imx8m-plus-can.dtsi"
#include "mcm-imx8m-plus-pcie.dtsi"
#include "mcm-imx8m-plus-eb-eth.dtsi"
#include "mcm-imx8m-plus-eb-audimx9.dtsi"
#include "mcm-imx8m-plus-mipi.dtsi"
#include "mcm-imx8m-plus-lvds.dtsi"
#include "mcm-imx8m-plus-hdmi.dtsi"

/ {
	model = "CompuLab MCM-iMX8M-Plus";
	compatible = "compulab,mcm-imx8m-plus", "fsl,imx8mp";
};
