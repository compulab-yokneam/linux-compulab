#include "overlay.h"

&{/chosen/overlays} {
	overlay-csi2-isp1-imx219 = "IMX219 camera on CSI2/ISP1 (J2)";
};

&i2c6 {
	#address-cells = <1>;
	#size-cells = <0>;

	camera1: camera@10 {
		compatible = "sony,imx219";
		reg = <0x10>;
	};
};

#include "sbev-ucmimx8plus-csi2-isp1-camera-common.dtsi"
