// SPDX-License-Identifier: (GPL-2.0+ OR MIT)
/*
 * Copyright 2026 CompuLab Ltd
 */

#include "ucm-imx8m-plus.dtsi"
#include "ucm-imx8m-plus-pcie.dtsi"
#include "ucm-imx8m-plus-can.dtsi"
#include "sb-iotgimx8pv2.dtsi"
#include "iotg-imx8pv2-sio.dtsi"

/ {
	model = "CompuLab IOT-GATE-IMX8PV2";
	compatible = "compulab,iot-gate-imx8pv2", "compulab,ucm-imx8m-plus-som", "fsl,imx8mp";
};
