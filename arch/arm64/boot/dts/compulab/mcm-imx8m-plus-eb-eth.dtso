#include "overlay.h"

&{/chosen/overlays} {
	overlay-mcm-imx8m-plus-eb-eth = "MCM-iMX8M-Plus: eb eth";
};

#include "mcm-imx8m-plus-eb-eth.dtsi"

/ {
	model = "CompuLab MCM-iMX8M-Plus (eb-eth)";
	compatible = "compulab,mcm-imx8m-plus", "fsl,imx8mp";
};
