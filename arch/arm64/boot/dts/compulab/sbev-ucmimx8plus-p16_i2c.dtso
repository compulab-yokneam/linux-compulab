#include "overlay.h"

&{/chosen/overlays} {
	overlay-sbev-ucmimx8plus-p16-i2c = "SBEV-UCM-iMX8Plus: p16 I2C";
};

#include "sbev-ucmimx8plus-p16_i2c.dtsi"

/ {
	model = "CompuLab MCM-iMX8M-Plus (p16_i2c)";
	compatible = "compulab,mcm-imx8m-plus", "fsl,imx8mp";
};
