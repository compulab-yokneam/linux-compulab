#include "overlay.h"

&{/chosen/overlays} {
	overlay-iotg-imx8pv2-do3 = "IOT-GATE-iMX8Plus v2: do3";
};

/* Disable Digital Input 3 by applying a hog configuration to the underlying GPIO. */

&di3_dis {
	status = "okay";
};

/* Enable Digital Output 3 by removing the hog configuration from the underlying GPIO. */
&do3_dis {
	status = "disabled";
};
