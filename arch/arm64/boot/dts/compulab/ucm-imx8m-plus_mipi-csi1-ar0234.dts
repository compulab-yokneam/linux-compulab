/dts-v1/;
/plugin/;

#include "overlay.h"
#include "ucm-imx8m-plus_mipi-csi1.dtsi"

/ {
	model = "CompuLab UCM-iMX8M-Plus with ar0234 mipi csi1 enabled";
	compatible = "compulab,ucm-imx8m-plus", "fsl,imx8mp";
};

&sensor_mipi1 {
	compatible = "econ,ar0234", "ar0234";
	camera-mipi-clk = <800>;
};
