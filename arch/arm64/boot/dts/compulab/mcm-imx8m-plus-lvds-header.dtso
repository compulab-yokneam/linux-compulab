#include "overlay.h"

&{/chosen/overlays} {
	overlay-mcm-imx8m-plus-lvds-header = "MCM-iMX8M-Plus: LVDS header";
};

&{/} {
	model = "CompuLab MCM-iMX8M-Plus (lvds)";
	compatible = "compulab,mcm-imx8m-plus", "fsl,imx8mp";
};
