// SPDX-License-Identifier: (GPL-2.0+ OR MIT)
/*
 * Copyright 2026 CompuLab Ltd.
 */

/dts-v1/;

#include "mcm-imx93.dtsi"
#include "mcm-imx93-mipi.dtsi"

/ {
	model = "CompuLab MCM-i.MX93 board, build-in-mipi";
	compatible = "compulab,mcm-imx93", "fsl,imx93";
};
