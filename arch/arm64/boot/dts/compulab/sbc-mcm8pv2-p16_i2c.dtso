// SPDX-License-Identifier: (GPL-2.0+ OR MIT)
/* Copyright 2026 CompuLab Ltd. */

#include "overlay.h"

&{/chosen/overlays} {
	overlay-sbc-mcm8pv2-p16_i2c = "SBC-MCM8PV2: I2C4 on P16";
};

#include "sbc-mcm8pv2-p16_i2c.dtsi"
