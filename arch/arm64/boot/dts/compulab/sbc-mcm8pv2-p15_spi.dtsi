// SPDX-License-Identifier: (GPL-2.0+ OR MIT)
/* Copyright 2026 CompuLab Ltd. */

&ecspi2 {
	#address-cells = <1>;
	#size-cells = <0>;
	num-cs = <1>;
	pinctrl-names = "default";
	pinctrl-0 = <&pinctrl_sbc_p15_spi>;
	cs-gpios = <&gpio5 13 GPIO_ACTIVE_LOW>;
	status = "okay";

	/* SBEV userspace SPI placeholder; replace for a specific peripheral. */
	spidev@0 {
		compatible = "rohm,dh2228fv";
		reg = <0>;
		spi-max-frequency = <500000>;
	};
};

&iomuxc {
	pinctrl_sbc_p15_spi: sbc-p15-spigrp {
		fsl,pins = <
			MX8MP_IOMUXC_ECSPI2_SCLK__ECSPI2_SCLK	0x82 /* P15.5 */
			MX8MP_IOMUXC_ECSPI2_MOSI__ECSPI2_MOSI	0x82 /* P15.3 */
			MX8MP_IOMUXC_ECSPI2_MISO__ECSPI2_MISO	0x82 /* P15.2 */
			MX8MP_IOMUXC_ECSPI2_SS0__GPIO5_IO13	0x40000 /* P15.4 */
		>;
	};
};
