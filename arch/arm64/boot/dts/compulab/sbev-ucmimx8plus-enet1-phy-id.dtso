// SPDX-License-Identifier: (GPL-2.0+ OR MIT)
/*
 * Copyright 2026 CompuLab Ltd.
 */

#include "overlay.h"

&{/chosen/overlays} {
	overlay-sbev-ucmimx8plus-enet1-phy-id = "SBEV-UCM-iMX8Plus: ENET1 PHY id";
};

&fec {
	phy-mode = "rgmii-id";
};
