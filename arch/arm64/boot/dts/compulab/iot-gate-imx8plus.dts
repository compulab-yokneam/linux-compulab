// SPDX-License-Identifier: (GPL-2.0+ OR MIT)
/*
 * Copyright 2022 CompuLab Ltd
 */

#include "ucm-imx8m-plus.dtsi"
#include "ucm-imx8m-plus-can.dtsi"
#include "ucm-imx8m-plus-pcie.dtsi"
#include "ucm-imx8m-plus-hdmi.dtsi"
#include "sb-iotgimx8plus.dtsi"

/ {
	model = "CompuLab IOT-GATE-IMX8PLUS";
	compatible = "compulab,iot-gate-imx8plus", "compulab,ucm-imx8m-plus-som", "fsl,imx8mp";
};
