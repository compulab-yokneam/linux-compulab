#include "overlay.h"

&{/chosen/overlays} {
	overlay-csi1-isp0-imx219 = "IMX219 camera on CSI1/ISP0 (J1)";
};

&i2c5 {
	#address-cells = <1>;
	#size-cells = <0>;

	camera0: camera@10 {
		compatible = "sony,imx219";
		reg = <0x10>;
	};
};

#include "sbev-ucmimx8plus-csi1-isp0-camera-common.dtsi"
