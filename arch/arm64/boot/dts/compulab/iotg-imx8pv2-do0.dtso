#include "overlay.h"

&{/chosen/overlays} {
	overlay-iotg-imx8pv2-do0 = "IOT-GATE-iMX8Plus v2: do0";
};

/* Disable Digital Input 0 by applying a hog configuration to the underlying GPIO. */

&di0_dis {
	status = "okay";
};

/* Enable Digital Output 0 by removing the hog configuration from the underlying GPIO. */
&do0_dis {
	status = "disabled";
};
