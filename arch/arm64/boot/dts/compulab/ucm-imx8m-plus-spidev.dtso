#include "overlay.h"

&{/chosen/overlays} {
	overlay-ucm-imx8m-plus-spidev = "UCM-iMX8M-Plus: SPI device";
};

#include "compulab-imx8m-plus-spidev.dtsi"

/ {
	model = "CompuLab UCM-iMX8M-Plus (spidev)";
	compatible = "compulab,ucm-imx8m-plus", "fsl,imx8mp";
};
