#include "overlay.h"

&{/chosen/overlays} {
	overlay-iotg-imx8pv2-do1 = "IOT-GATE-iMX8Plus v2: do1";
};

/* Disable Digital Input 1 by applying a hog configuration to the underlying GPIO. */

&di1_dis {
	status = "okay";
};

/* Enable Digital Output 1 by removing the hog configuration from the underlying GPIO. */
&do1_dis {
	status = "disabled";
};
