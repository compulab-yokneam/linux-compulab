#include "overlay.h"

&{/chosen/overlays} {
	overlay-csi1-isp0-ov5647 = "OV5647 camera on CSI1/ISP0 (J1)";
};

&i2c5 {
	#address-cells = <1>;
	#size-cells = <0>;

	camera0: camera@36 {
		compatible = "ovti,ov5647";
		reg = <0x36>;
	};
};

#include "sbev-ucmimx8plus-csi1-isp0-camera-common.dtsi"
