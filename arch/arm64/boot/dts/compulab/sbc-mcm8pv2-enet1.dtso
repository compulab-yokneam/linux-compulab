// SPDX-License-Identifier: (GPL-2.0+ OR MIT)
/* Copyright 2026 CompuLab Ltd. */

#include "overlay.h"

&{/chosen/overlays} {
	overlay-sbc-mcm8pv2-enet1 = "SBC-MCM8PV2: enet1";
};

#include "sbc-mcm8pv2-enet1.dtsi"
