// SPDX-License-Identifier: (GPL-2.0+ OR MIT)
/*
 * Copyright 2021 CompuLab
 */

/dts-v1/;

#include "mcm-imx8m-plus-pinctrl.dtsi"
#include "mcm-imx8m-plus.dtsi"

/ {
	model = "CompuLab MCM-iMX8M-Plus (headless)";
	compatible = "compulab,mcm-imx8m-plus", "fsl,imx8mp";
};
