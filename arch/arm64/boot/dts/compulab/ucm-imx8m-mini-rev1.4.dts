/*
 * Copyright 2018 CompuLab
 *
 * This program is free software; you can redistribute it and/or
 * modify it under the terms of the GNU General Public License
 * as published by the Free Software Foundation; either version 2
 * of the License, or (at your option) any later version.
 *
 * This program is distributed in the hope that it will be useful,
 * but WITHOUT ANY WARRANTY; without even the implied warranty of
 * MERCHANTABILITY or FITNESS FOR A PARTICULAR PURPOSE.  See the
 * GNU General Public License for more details.
 */

/dts-v1/;

#include "ucm-imx8m-mini.dtsi"
#include "sb-ucm-imx8-rev2.dtsi"
#include "wifi-iw612.dtsi"

/ {
	model = "CompuLab UCM i.MX8MM board rev 1.4";
	compatible = "cpl,ucm-imx8m-mini", "fsl,imx8mm";
};
