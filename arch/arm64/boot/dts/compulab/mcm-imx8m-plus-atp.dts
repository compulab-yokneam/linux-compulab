// SPDX-License-Identifier: (GPL-2.0+ OR MIT)
/*
 * Copyright 2024 CompuLab
 */

/dts-v1/;

#include "mcm-imx8m-plus-som.dts"
#include "mcm-imx8m-plus-mmc2.dtsi"
#include "mcm-imx8m-plus-mmc1.dtsi"
#include "mcm-imx8m-plus-can.dtsi"
#include "mcm-imx8m-plus-pcie.dtsi"
#include "mcm-imx8m-plus-mipi.dtsi"
#include "mcm-imx8m-plus-hdmi.dtsi"
#include "mcm-imx8m-plus-atp.dtsi"

/ {
	model = "CompuLab MCM-iMX8M-Plus";
	compatible = "compulab,mcm-imx8m-plus", "fsl,imx8mp";
};
