#include "overlay.h"

&{/chosen/overlays} {
	overlay-ucm-imx8m-plus-mipi-csi2-ar1335-af = "UCM-iMX8M-Plus: MIPI CSI2 AR1335 AF";
};

#include "ucm-imx8m-plus_mipi-csi2.dtsi"

&{/} {
	model = "CompuLab UCM-iMX8M-Plus with ar_1335_af mipi csi2 enabled";
	compatible = "compulab,ucm-imx8m-plus", "fsl,imx8mp";
};

&sensor_mipi2 {
	compatible = "econ,ar1335_af", "ar1335_af";
};
