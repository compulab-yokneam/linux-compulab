#include "overlay.h"

&{/chosen/overlays} {
	overlay-ucm-imx8m-plus-mipi = "UCM-iMX8M-Plus: MIPI";
};

#include "ucm-imx8m-plus-mipi.dtsi"

&{/} {
	model = "CompuLab UCM-iMX8M-Plus (mipi)";
	compatible = "compulab,ucm-imx8m-plus", "fsl,imx8mp";
};
