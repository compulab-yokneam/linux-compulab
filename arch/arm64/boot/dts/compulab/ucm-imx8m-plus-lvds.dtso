#include "overlay.h"

&{/chosen/overlays} {
	overlay-ucm-imx8m-plus-lvds = "UCM-iMX8M-Plus: LVDS";
};

#include "ucm-imx8m-plus-lvds.dtsi"

&{/} {
	model = "CompuLab UCM-iMX8M-Plus (lvds)";
	compatible = "compulab,ucm-imx8m-plus", "fsl,imx8mp";
};
