// SPDX-License-Identifier: (GPL-2.0+ OR MIT)
/*
 * Copyright 2026 CompuLab Ltd.
 */

/dts-v1/;

#include "sbc-mcm-imx93.dts"
#include "mcm-imx93-thermal.dtsi"

/ {
	model = "CompuLab MCM-i.MX93 board, thermal";
	compatible = "compulab,mcm-imx93", "fsl,imx93";
};
