/delete-node/ &mipi_ts;

&i2c6 {
	#address-cells = <1>;
	#size-cells = <0>;
	status = "okay";

	goodix_ts@5d {
		compatible = "goodix,gt911";
		reg = <0x5d>;

		interrupt-parent = <&gpio3>;
		interrupts = <22 IRQ_TYPE_LEVEL_HIGH>;

		pinctrl-names = "default";
		pinctrl-0 = <&touchscreen_pins>;

		irq-gpios = <&gpio3 22 GPIO_ACTIVE_HIGH>;
		reset-gpios = <&pca9555 5 GPIO_ACTIVE_HIGH>;
		status = "okay";
	};
};
