// SPDX-License-Identifier: (GPL-2.0+ OR MIT)
/* Copyright 2026 CompuLab Ltd. */

#include "overlay.h"

&{/chosen/overlays} {
	overlay-sbc-mcm8pv2-wm8962 = "SBC-MCM8PV2: WM8962 audio";
};

#include "sbc-mcm8pv2-wm8962.dtsi"
