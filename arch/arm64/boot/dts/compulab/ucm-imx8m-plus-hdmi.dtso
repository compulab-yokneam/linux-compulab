#include "overlay.h"

&{/chosen/overlays} {
	overlay-ucm-imx8m-plus-hdmi = "UCM-iMX8M-Plus: HDMI";
};

#include "ucm-imx8m-plus-hdmi.dtsi"

&{/} {
	model = "CompuLab UCM-iMX8M-Plus (hdmi)";
	compatible = "compulab,ucm-imx8m-plus", "fsl,imx8mp";
};
