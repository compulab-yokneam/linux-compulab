/*
 * Copyright 2022 CompuLab
 *
 * This program is free software; you can redistribute it and/or
 * modify it under the terms of the GNU General Public License
 * as published by the Free Software Foundation; either version 2
 * of the License, or (at your option) any later version.
 *
 * This program is distributed in the hope that it will be useful,
 * but WITHOUT ANY WARRANTY; without even the implied warranty of
 * MERCHANTABILITY or FITNESS FOR A PARTICULAR PURPOSE.  See the
 * GNU General Public License for more details.
 */

&cpu_alert0 {
	temperature = <125000>;
};

&cpu_crit0 {
	temperature = <155000>;
};

&soc_alert0 {
	temperature = <125000>;
};

&soc_crit0 {
	temperature = <155000>;
};
