/*
 * Copyright (C) 2018 CopuLab Ltd.
 *
 * This program is free software; you can redistribute it and/or
 * modify it under the terms of the GNU General Public License
 * as published by the Free Software Foundation; either version 2
 * of the License, or (at your option) any later version.
 *
 * This program is distributed in the hope that it will be useful,
 * but WITHOUT ANY WARRANTY; without even the implied warranty of
 * MERCHANTABILITY or FITNESS FOR A PARTICULAR PURPOSE.  See the
 * GNU General Public License for more details.
 */

#include "sbc-imx8.dts"
#include "compulab-imx8mq-lvds-mipi.dtsi"
#include "compulab-imx8mq-mipi-lcdif.dtsi"

&i2c3 {
    status = "okay";
    goodix_ts@5d {
    compatible = "goodix,gt911";
        reg = <0x5d>;

        interrupt-parent = <&gpio3>;
        interrupts = <3 IRQ_TYPE_EDGE_FALLING>;

        pinctrl-names = "default";
        pinctrl-0 = <&touchscreen_pins>;

        irq-gpios = <&gpio3 3 GPIO_ACTIVE_HIGH>;
        reset-gpios = <&gpio3 4 GPIO_ACTIVE_HIGH>;
        status = "okay";
    };
};
