/dts-v1/;
/plugin/;

#include "overlay.h"
#include "ucm-imx8m-plus_mipi-csi1.dtsi"

&{/} {
	model = "CompuLab UCM-iMX8M-Plus with ar_0521 mipi csi1 enabled";
	compatible = "compulab,ucm-imx8m-plus", "fsl,imx8mp";
};

&sensor_mipi1 {
	compatible = "econ,ar0521", "ar0521";
};
