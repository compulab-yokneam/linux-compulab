#include "overlay.h"

&{/chosen/overlays} {
	overlay-sbev-ucmimx8plus-p20-uart-a = "SBEV-UCM-iMX8Plus: p20 UART a";
};

#include "sbev-ucmimx8plus-p20_uart-a.dtsi"

/ {
	model = "CompuLab MCM-iMX8M-Plus (p20_uart-a)";
	compatible = "compulab,mcm-imx8m-plus", "fsl,imx8mp";
};
