#include "overlay.h"

&{/chosen/overlays} {
	overlay-sbev-ucmimx8plus-p18-gpio-config = "SBEV-UCM-iMX8Plus: p18 GPIO";
};

#include "sbev-ucmimx8plus-p18_gpio.dtsi"

/ {
	model = "CompuLab MCM-iMX8M-Plus (p18_gpio)";
	compatible = "compulab,mcm-imx8m-plus", "fsl,imx8mp";
};
