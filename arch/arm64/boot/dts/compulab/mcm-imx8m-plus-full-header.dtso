#include "overlay.h"

&{/chosen/overlays} {
	overlay-mcm-imx8m-plus-full-header = "MCM-iMX8M-Plus: full header";
};

&{/} {
	model = "CompuLab MCM-iMX8M-Plus (full)";
	compatible = "compulab,mcm-imx8m-plus", "fsl,imx8mp";
};
