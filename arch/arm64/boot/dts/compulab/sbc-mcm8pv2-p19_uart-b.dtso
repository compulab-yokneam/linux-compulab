// SPDX-License-Identifier: (GPL-2.0+ OR MIT)
/* Copyright 2026 CompuLab Ltd. */

#include "overlay.h"

&{/chosen/overlays} {
	overlay-sbc-mcm8pv2-p19_uart-b = "SBC-MCM8PV2: UART4 on P19";
};

#include "sbc-mcm8pv2-p19_uart-b.dtsi"
