// SPDX-License-Identifier: (GPL-2.0+ OR MIT)
/*
 * Copyright 2024 Compulab
 */

&lpi2c1 {
	rtc@69 {
		compatible = "ab1805";
		reg = <0x69>;
		pagesize = <16>;
		sqw = "32768_hz";
		xt-frequency = <32772300>;
		status = "okay";
	};
};
