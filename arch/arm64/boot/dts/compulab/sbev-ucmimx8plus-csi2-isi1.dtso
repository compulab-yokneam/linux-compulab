#include "overlay.h"

&{/chosen/overlays} {
	overlay-sbev-ucmimx8plus-csi2-isi1 = "SBEV-UCM-iMX8Plus: CSI2 ISI1";
};

#include "sbev-ucmimx8plus-csi2-isi1.dtsi"

&{/} {
	model = "CompuLab UCM-iMX8M-Plus with csi2/isi1 enabled on EB-EVCAMBLR";
	compatible = "compulab,ucm-imx8m-plus", "fsl,imx8mp";
};
