// SPDX-License-Identifier: (GPL-2.0+ OR MIT)
/*
 * Copyright 2022 NXP
 */

/dts-v1/;
/plugin/;

#include <dt-bindings/gpio/gpio.h>
#include <dt-bindings/interrupt-controller/arm-gic.h>
#include "ucm-imx93-lvds.dtsi"

/ {
	model = "CompuLab UCM-i.MX93 board, lvds-overalay";
};
