#include "overlay.h"

&{/chosen/overlays} {
	overlay-mcm-imx8m-plus-uart3 = "MCM-iMX8M-Plus: UART3";
};

#include "mcm-imx8m-plus-uart3.dtsi"

/ {
	model = "CompuLab MCM-iMX8M-Plus (uart3)";
	compatible = "compulab,mcm-imx8m-plus", "fsl,imx8mp";
};
