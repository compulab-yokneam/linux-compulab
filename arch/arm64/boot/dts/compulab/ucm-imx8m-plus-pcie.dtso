#include "overlay.h"

&{/chosen/overlays} {
	overlay-ucm-imx8m-plus-pcie = "UCM-iMX8M-Plus: PCIe";
};

#include "ucm-imx8m-plus-pcie.dtsi"

/ {
	model = "CompuLab UCM-iMX8M-Plus (pice)";
	compatible = "compulab,ucm-imx8m-plus", "fsl,imx8mp";
};
