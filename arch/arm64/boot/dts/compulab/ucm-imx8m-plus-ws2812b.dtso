#include "overlay.h"

&{/chosen/overlays} {
	overlay-ucm-imx8m-plus-ws2812b = "UCM-iMX8M-Plus: ws2812b";
};

#include "compulab-imx8m-plus-ws2812b.dtsi"

/ {
	model = "CompuLab UCM-iMX8M-Plus (ws28l2b on spi2)";
	compatible = "compulab,ucm-imx8m-plus", "fsl,imx8mp";
};
