## drivers/media/platform/imx8/Kconfig
```kconfig
if VIDEO_MX8_CAPTURE
menu "IMX8 Camera ISI/MIPI Features support"

config IMX8_MIPI_CSI2_YAV
	tristate "IMX8 MIPI CSI2 Controller Yet Another Version"
	default y

endmenu

config VIDEO_ECAM
        tristate "e-con camera sensor support"
        depends on I2C && VIDEO_V4L2_SUBDEV_API
        help
          This config is used to enable codes which are used to
          support econ camera and to disable ISI control codes.

          To compile this driver as a module, choose M here: the module
          will be called based on sensor name.

source "drivers/media/platform/imx8/ecam/Kconfig"

endif #VIDEO_MX8_CAPTURE
```

## drivers/media/platform/imx8/ecam/Kconfig
```kconfig
if VIDEO_ECAM
menu "IMX8 eCon Camera ISI/MIPI Features support"

config MXC_CAMERA_AR0521
        tristate "AR0521 Camera driver support"
        depends on I2C && VIDEO_ECAM
        default n
        help
          Enable support for video4linux camera sensor driver for eCAM50_CUIMX8

config MXC_CAMERA_AR1335
        tristate "AR1335 Camera driver support"
        depends on I2C && VIDEO_ECAM
        default n
        help
          Enable support for video4linux camera sensor driver for eCAM131_CUIMX8

config MXC_CAMERA_AR1335_AF
        tristate "AR1335 Auto focus Camera driver support"
        depends on I2C && VIDEO_ECAM
        default n
        help
          Enable support for video4linux camera sensor driver for eCAM136_IMX8

config MXC_CAMERA_AR1335_MCU
        tristate "AR1335 MCU Camera driver support"
        depends on I2C && VIDEO_ECAM
        default n
        help
          Enable support for video4linux camera sensor driver for eCAM130

config MXC_CAMERA_AR0234
        tristate "AR0234 Camera driver support"
        depends on I2C && VIDEO_ECAM
        default n 
        help
          Enable support for video4linux camera sensor driver for eCAM21_CUIMX8

endmenu
endif #VIDEO_ECAM
```

## drivers/staging/em9190/Kconfig
```kconfig
# SPDX-License-Identifier: GPL-2.0
config EM9190
	tristate "EM9190 - Sierra Wireless PCIe Driver"
	help
	  This option allows you to enable support for the EM9190 modem
```
